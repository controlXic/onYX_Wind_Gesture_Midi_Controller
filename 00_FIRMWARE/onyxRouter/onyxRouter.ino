/*
 * .:Control Xic:.
 * 
 * Josep Puig Villalon
 * 
 * ESP32 module = "ESP32 Dev Module"
 * 
 */

#include <WiFi.h>
#include <WiFiUdp.h>
#include <WiFiAP.h>
#include <U8g2lib.h>
#include <Wire.h>

// LCD 128x64 & logo //
U8G2_SH1106_128X64_NONAME_F_HW_I2C u8g2(U8G2_R0, /* reset=*/ U8X8_PIN_NONE);

#define logo_width 67
#define logo_height 60

const unsigned char logo[] U8X8_PROGMEM  = {
  0x00, 0x00, 0x00, 0x00, 0x00, 0x00, 0x00, 0x00, 0x00, 0x00, 0x00, 0x00, 
  0x00, 0x00, 0x00, 0x00, 0x00, 0x00, 0x00, 0x00, 0x00, 0x00, 0x00, 0x00, 
  0x00, 0x00, 0x00, 0x00, 0x00, 0x00, 0x00, 0x00, 0x69, 0x03, 0x00, 0x00, 
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  0x00, 0x00, 0x00, 0x00, 0x00, 0x00, 0x00, 0x00, 0x00, 0x00, 0x00, 0x00, 
  };
  
// WIFI //
const char* ssid = "C_X_Saxpler_1";
const char* password = "1a3c5e7g9";

unsigned int localUdpPort = 2000;  // local port to listen on
char incomingPacket[255];  // buffer for incoming packets
char replyPacekt[255] = "e";  // a reply string to send back

IPAddress APlocal_IP(192, 168, 4, 1);
IPAddress APgateway(192, 168, 4, 1);
IPAddress APsubnet(255, 255, 255, 0);
WiFiUDP Udp;

// Sereial debug //
int incomingByte = 0; 


void setup()
{
  pinMode(2, OUTPUT);
  digitalWrite(2, LOW);       // sets the digital pin 13 on
 
  Serial.begin(115200);
  Serial.println("Router onYX");

  Serial2.begin(115200);
  Serial2.println();
  
/*
  // LCD 128x64 //
  u8g2.begin();
  u8g2.firstPage();
*/

/*  
  // Print logo C_X //
  do{
      u8g2.drawXBMP(30, 2, logo_width, logo_height, logo);
  }
  while( u8g2.nextPage() );

  
  //delay(5000);
  u8g2.clearDisplay();
  u8g2.clearBuffer();          
  u8g2.setFont(u8g2_font_helvR18_tf);  
  u8g2.drawStr(35,40,"onYX"); 
  u8g2.sendBuffer();          
  u8g2.clearBuffer();
*/ 

  // wifi & udp //
  //Serial.print("Configuring access point... IP: ");
  WiFi.mode(WIFI_AP);
  WiFi.softAPConfig(APlocal_IP, APgateway, APsubnet);
  WiFi.softAP(ssid, password);
  Serial.println(WiFi.softAPIP()); // Confirm AP IP address

  while(WiFi.softAPgetStationNum() != 3)//espera que es connectin els mandos = 3
  {
    delay(500);
    Serial.print(".");
  }  

  Udp.begin(APlocal_IP, localUdpPort);
  Serial.print("Local UDP port: ");
  Serial.println(localUdpPort);

  
  Serial.printf("Stations connected = %d\n", WiFi.softAPgetStationNum());
  digitalWrite(2, HIGH);



}


void loop()
{
  
/*
  if (Serial2.available() > 0) 
  {
   Serial.print((char)Serial2.read());
  }
*/
  
///////////////////////////////////////////////////////////////////
// Rececpció UDP i enviamnet per serial
///////////////////////////////////////////////////////////////////


  int packetSize = Udp.parsePacket();
  if(packetSize)
  {
    // Serial.printf("Received %d bytes from %s, port %d\n", packetSize, Udp.remoteIP().toString().c_str(), Udp.remotePort());
    int len = Udp.read(incomingPacket, 40);//16
    if (len > 0)
    {
      incomingPacket[len] = 0;
    }
    
    if(incomingPacket[0] != 's') Serial2.println(incomingPacket);
    
    //Serial.println(incomingPacket);//debug  
    //Serial.print(incomingPacket[10], DEC);//debug   
    //Serial.print(" - ");//debug   
    //Serial.println(incomingPacket[11], DEC);//debug   
 
  }


/////////////////////////////////////////////////////////////////////////////////////////////////////
// Lectura missatge mando dreta per l'activació dels giroscopis i reenviament a mando esquerra 
/////////////////////////////////////////////////////////////////////////////////////////////////////


  if (Udp.remoteIP().toString() == "192.168.4.177" && incomingPacket[0] == 's')
  {
    const char ipLeft[] = "192.168.4.188"; 
    Udp.beginPacket(ipLeft, 5000);
    Udp.printf(incomingPacket);
    Udp.endPacket();
    Udp.remoteIP().toString() = "";    
  }


} 
